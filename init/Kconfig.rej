## init/Kconfig.rej
```kconfig
--- init/Kconfig	2009-12-03 21:40:09.000000000 +1100
+++ init/Kconfig	2010-12-16 16:07:44.252620749 +1100
@@ -441,7 +454,7 @@
 
 config GROUP_SCHED
 	bool "Group CPU scheduler"
-	depends on EXPERIMENTAL
+	depends on EXPERIMENTAL && !SCHED_BFS
 	default n
 	help
 	  This feature lets CPU scheduler recognize task groups and control CPU
```
